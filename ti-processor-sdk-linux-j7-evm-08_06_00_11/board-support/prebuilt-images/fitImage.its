## ti-processor-sdk-linux-j7-evm-08_06_00_11/board-support/prebuilt-images/fitImage.its
```
/dts-v1/;

/ {
        description = "U-Boot fitImage for Arago/5.10.162+gitAUTOINC+76b3e88d56/j7-evm";
        #address-cells = <1>;

        images {
                kernel@1 {
                        description = "Linux kernel";
                        data = /incbin/("Image.sec");
                        type = "kernel";
                        arch = "arm64";
                        os = "linux";
                        compression = "none";
                        load = <0x80008000>;
                        entry = <0x80008000>;
                };
                k3-j721e-common-proc-board.dtb {
                        description = "Flattened Device Tree blob";
                        data = /incbin/("k3-j721e-common-proc-board.dtb.sec");
                        type = "flat_dt";
                        arch = "arm64";
                        compression = "none";
                        load = <0x83000000>;
                };
                k3-j721e-proc-board-tps65917.dtb {
                        description = "Flattened Device Tree blob";
                        data = /incbin/("k3-j721e-proc-board-tps65917.dtb.sec");
                        type = "flat_dt";
                        arch = "arm64";
                        compression = "none";
                        load = <0x83000000>;
                };
                k3-j721e-common-proc-board-infotainment.dtbo {
                        description = "Flattened Device Tree blob";
                        data = /incbin/("k3-j721e-common-proc-board-infotainment.dtbo.sec");
                        type = "flat_dt";
                        arch = "arm64";
                        compression = "none";
                        load = <0x83080000>;
                };
                k3-j721e-cpb-csi2-ov5640.dtbo {
                        description = "Flattened Device Tree blob";
                        data = /incbin/("k3-j721e-cpb-csi2-ov5640.dtbo.sec");
                        type = "flat_dt";
                        arch = "arm64";
                        compression = "none";
                        load = <0x83090000>;
                };
                k3-j721e-fpdlink-cpb-fusion.dtbo {
                        description = "Flattened Device Tree blob";
                        data = /incbin/("k3-j721e-fpdlink-cpb-fusion.dtbo.sec");
                        type = "flat_dt";
                        arch = "arm64";
                        compression = "none";
                        load = <0x830a0000>;
                };
                k3-j721e-fpdlink-imx390-cm-0-0.dtbo {
                        description = "Flattened Device Tree blob";
                        data = /incbin/("k3-j721e-fpdlink-imx390-cm-0-0.dtbo.sec");
                        type = "flat_dt";
                        arch = "arm64";
                        compression = "none";
                        load = <0x830b0000>;
                };
                k3-j721e-fpdlink-imx390-cm-0-1.dtbo {
                        description = "Flattened Device Tree blob";
                        data = /incbin/("k3-j721e-fpdlink-imx390-cm-0-1.dtbo.sec");
                        type = "flat_dt";
                        arch = "arm64";
                        compression = "none";
                        load = <0x830c0000>;
                };
                k3-j721e-fpdlink-imx390-cm-0-2.dtbo {
                        description = "Flattened Device Tree blob";
                        data = /incbin/("k3-j721e-fpdlink-imx390-cm-0-2.dtbo.sec");
                        type = "flat_dt";
                        arch = "arm64";
                        compression = "none";
                        load = <0x830d0000>;
                };
                k3-j721e-fpdlink-imx390-cm-0-3.dtbo {
                        description = "Flattened Device Tree blob";
                        data = /incbin/("k3-j721e-fpdlink-imx390-cm-0-3.dtbo.sec");
                        type = "flat_dt";
                        arch = "arm64";
                        compression = "none";
                        load = <0x830e0000>;
                };
                k3-j721e-fpdlink-imx390-cm-1-0.dtbo {
                        description = "Flattened Device Tree blob";
                        data = /incbin/("k3-j721e-fpdlink-imx390-cm-1-0.dtbo.sec");
                        type = "flat_dt";
                        arch = "arm64";
                        compression = "none";
                        load = <0x830f0000>;
                };
                k3-j721e-fpdlink-imx390-cm-1-1.dtbo {
                        description = "Flattened Device Tree blob";
                        data = /incbin/("k3-j721e-fpdlink-imx390-cm-1-1.dtbo.sec");
                        type = "flat_dt";
                        arch = "arm64";
                        compression = "none";
                        load = <0x83100000>;
                };
                k3-j721e-fpdlink-imx390-cm-1-2.dtbo {
                        description = "Flattened Device Tree blob";
                        data = /incbin/("k3-j721e-fpdlink-imx390-cm-1-2.dtbo.sec");
                        type = "flat_dt";
                        arch = "arm64";
                        compression = "none";
                        load = <0x83110000>;
                };
                k3-j721e-fpdlink-imx390-cm-1-3.dtbo {
                        description = "Flattened Device Tree blob";
                        data = /incbin/("k3-j721e-fpdlink-imx390-cm-1-3.dtbo.sec");
                        type = "flat_dt";
                        arch = "arm64";
                        compression = "none";
                        load = <0x83120000>;
                };
                k3-j721e-fpdlink-imx390-rcm-0-0.dtbo {
                        description = "Flattened Device Tree blob";
                        data = /incbin/("k3-j721e-fpdlink-imx390-rcm-0-0.dtbo.sec");
                        type = "flat_dt";
                        arch = "arm64";
                        compression = "none";
                        load = <0x83130000>;
                };
                k3-j721e-fpdlink-imx390-rcm-0-1.dtbo {
                        description = "Flattened Device Tree blob";
                        data = /incbin/("k3-j721e-fpdlink-imx390-rcm-0-1.dtbo.sec");
                        type = "flat_dt";
                        arch = "arm64";
                        compression = "none";
                        load = <0x83140000>;
                };
                k3-j721e-fpdlink-imx390-rcm-0-2.dtbo {
                        description = "Flattened Device Tree blob";
                        data = /incbin/("k3-j721e-fpdlink-imx390-rcm-0-2.dtbo.sec");
                        type = "flat_dt";
                        arch = "arm64";
                        compression = "none";
                        load = <0x83150000>;
                };
                k3-j721e-fpdlink-imx390-rcm-0-3.dtbo {
                        description = "Flattened Device Tree blob";
                        data = /incbin/("k3-j721e-fpdlink-imx390-rcm-0-3.dtbo.sec");
                        type = "flat_dt";
                        arch = "arm64";
                        compression = "none";
                        load = <0x83160000>;
                };
                k3-j721e-fpdlink-imx390-rcm-1-0.dtbo {
                        description = "Flattened Device Tree blob";
                        data = /incbin/("k3-j721e-fpdlink-imx390-rcm-1-0.dtbo.sec");
                        type = "flat_dt";
                        arch = "arm64";
                        compression = "none";
                        load = <0x83170000>;
                };
                k3-j721e-fpdlink-imx390-rcm-1-1.dtbo {
                        description = "Flattened Device Tree blob";
                        data = /incbin/("k3-j721e-fpdlink-imx390-rcm-1-1.dtbo.sec");
                        type = "flat_dt";
                        arch = "arm64";
                        compression = "none";
                        load = <0x83180000>;
                };
                k3-j721e-fpdlink-imx390-rcm-1-2.dtbo {
                        description = "Flattened Device Tree blob";
                        data = /incbin/("k3-j721e-fpdlink-imx390-rcm-1-2.dtbo.sec");
                        type = "flat_dt";
                        arch = "arm64";
                        compression = "none";
                        load = <0x83190000>;
                };
                k3-j721e-fpdlink-imx390-rcm-1-3.dtbo {
                        description = "Flattened Device Tree blob";
                        data = /incbin/("k3-j721e-fpdlink-imx390-rcm-1-3.dtbo.sec");
                        type = "flat_dt";
                        arch = "arm64";
                        compression = "none";
                        load = <0x831a0000>;
                };
                k3-j721e-sk.dtb {
                        description = "Flattened Device Tree blob";
                        data = /incbin/("k3-j721e-sk.dtb.sec");
                        type = "flat_dt";
                        arch = "arm64";
                        compression = "none";
                        load = <0x83000000>;
                };
                k3-j721e-fpdlink-sk-fusion.dtbo {
                        description = "Flattened Device Tree blob";
                        data = /incbin/("k3-j721e-fpdlink-sk-fusion.dtbo.sec");
                        type = "flat_dt";
                        arch = "arm64";
                        compression = "none";
                        load = <0x831b0000>;
                };
                k3-j721e-sk-csi2-ov5640.dtbo {
                        description = "Flattened Device Tree blob";
                        data = /incbin/("k3-j721e-sk-csi2-ov5640.dtbo.sec");
                        type = "flat_dt";
                        arch = "arm64";
                        compression = "none";
                        load = <0x831c0000>;
                };
                k3-j721e-sk-rpi-cam-imx219.dtbo {
                        description = "Flattened Device Tree blob";
                        data = /incbin/("k3-j721e-sk-rpi-cam-imx219.dtbo.sec");
                        type = "flat_dt";
                        arch = "arm64";
                        compression = "none";
                        load = <0x831d0000>;
                };
                k3-j721e-vision-apps.dtbo {
                        description = "Flattened Device Tree blob";
                        data = /incbin/("k3-j721e-vision-apps.dtbo.sec");
                        type = "flat_dt";
                        arch = "arm64";
                        compression = "none";
                        load = <0x831e0000>;
                };
                k3-j721e-edgeai-apps.dtbo {
                        description = "Flattened Device Tree blob";
                        data = /incbin/("k3-j721e-edgeai-apps.dtbo.sec");
                        type = "flat_dt";
                        arch = "arm64";
                        compression = "none";
                        load = <0x831f0000>;
                };
                k3-j721e-sk-rpi-hdr-ehrpwm.dtbo {
                        description = "Flattened Device Tree blob";
                        data = /incbin/("k3-j721e-sk-rpi-hdr-ehrpwm.dtbo.sec");
                        type = "flat_dt";
                        arch = "arm64";
                        compression = "none";
                        load = <0x83200000>;
                };
        };

        configurations {
                default = "k3-j721e-common-proc-board.dtb";
                k3-j721e-common-proc-board.dtb {
                        description = "Linux kernel, FDT blob";
                        fdt = "k3-j721e-common-proc-board.dtb";
                        kernel = "kernel@1";
                        
                        
                        
                };
                k3-j721e-proc-board-tps65917.dtb {
                        description = "Linux kernel, FDT blob";
                        fdt = "k3-j721e-proc-board-tps65917.dtb";
                        kernel = "kernel@1";
                        
                        
                        
                };
                k3-j721e-common-proc-board-infotainment.dtbo {
                        description = "Linux kernel, FDT blob";
                        fdt = "k3-j721e-common-proc-board-infotainment.dtbo";
                };
                k3-j721e-cpb-csi2-ov5640.dtbo {
                        description = "Linux kernel, FDT blob";
                        fdt = "k3-j721e-cpb-csi2-ov5640.dtbo";
                };
                k3-j721e-fpdlink-cpb-fusion.dtbo {
                        description = "Linux kernel, FDT blob";
                        fdt = "k3-j721e-fpdlink-cpb-fusion.dtbo";
                };
                k3-j721e-fpdlink-imx390-cm-0-0.dtbo {
                        description = "Linux kernel, FDT blob";
                        fdt = "k3-j721e-fpdlink-imx390-cm-0-0.dtbo";
                };
                k3-j721e-fpdlink-imx390-cm-0-1.dtbo {
                        description = "Linux kernel, FDT blob";
                        fdt = "k3-j721e-fpdlink-imx390-cm-0-1.dtbo";
                };
                k3-j721e-fpdlink-imx390-cm-0-2.dtbo {
                        description = "Linux kernel, FDT blob";
                        fdt = "k3-j721e-fpdlink-imx390-cm-0-2.dtbo";
                };
                k3-j721e-fpdlink-imx390-cm-0-3.dtbo {
                        description = "Linux kernel, FDT blob";
                        fdt = "k3-j721e-fpdlink-imx390-cm-0-3.dtbo";
                };
                k3-j721e-fpdlink-imx390-cm-1-0.dtbo {
                        description = "Linux kernel, FDT blob";
                        fdt = "k3-j721e-fpdlink-imx390-cm-1-0.dtbo";
                };
                k3-j721e-fpdlink-imx390-cm-1-1.dtbo {
                        description = "Linux kernel, FDT blob";
                        fdt = "k3-j721e-fpdlink-imx390-cm-1-1.dtbo";
                };
                k3-j721e-fpdlink-imx390-cm-1-2.dtbo {
                        description = "Linux kernel, FDT blob";
                        fdt = "k3-j721e-fpdlink-imx390-cm-1-2.dtbo";
                };
                k3-j721e-fpdlink-imx390-cm-1-3.dtbo {
                        description = "Linux kernel, FDT blob";
                        fdt = "k3-j721e-fpdlink-imx390-cm-1-3.dtbo";
                };
                k3-j721e-fpdlink-imx390-rcm-0-0.dtbo {
                        description = "Linux kernel, FDT blob";
                        fdt = "k3-j721e-fpdlink-imx390-rcm-0-0.dtbo";
                };
                k3-j721e-fpdlink-imx390-rcm-0-1.dtbo {
                        description = "Linux kernel, FDT blob";
                        fdt = "k3-j721e-fpdlink-imx390-rcm-0-1.dtbo";
                };
                k3-j721e-fpdlink-imx390-rcm-0-2.dtbo {
                        description = "Linux kernel, FDT blob";
                        fdt = "k3-j721e-fpdlink-imx390-rcm-0-2.dtbo";
                };
                k3-j721e-fpdlink-imx390-rcm-0-3.dtbo {
                        description = "Linux kernel, FDT blob";
                        fdt = "k3-j721e-fpdlink-imx390-rcm-0-3.dtbo";
                };
                k3-j721e-fpdlink-imx390-rcm-1-0.dtbo {
                        description = "Linux kernel, FDT blob";
                        fdt = "k3-j721e-fpdlink-imx390-rcm-1-0.dtbo";
                };
                k3-j721e-fpdlink-imx390-rcm-1-1.dtbo {
                        description = "Linux kernel, FDT blob";
                        fdt = "k3-j721e-fpdlink-imx390-rcm-1-1.dtbo";
                };
                k3-j721e-fpdlink-imx390-rcm-1-2.dtbo {
                        description = "Linux kernel, FDT blob";
                        fdt = "k3-j721e-fpdlink-imx390-rcm-1-2.dtbo";
                };
                k3-j721e-fpdlink-imx390-rcm-1-3.dtbo {
                        description = "Linux kernel, FDT blob";
                        fdt = "k3-j721e-fpdlink-imx390-rcm-1-3.dtbo";
                };
                k3-j721e-sk.dtb {
                        description = "Linux kernel, FDT blob";
                        fdt = "k3-j721e-sk.dtb";
                        kernel = "kernel@1";
                        
                        
                        
                };
                k3-j721e-fpdlink-sk-fusion.dtbo {
                        description = "Linux kernel, FDT blob";
                        fdt = "k3-j721e-fpdlink-sk-fusion.dtbo";
                };
                k3-j721e-sk-csi2-ov5640.dtbo {
                        description = "Linux kernel, FDT blob";
                        fdt = "k3-j721e-sk-csi2-ov5640.dtbo";
                };
                k3-j721e-sk-rpi-cam-imx219.dtbo {
                        description = "Linux kernel, FDT blob";
                        fdt = "k3-j721e-sk-rpi-cam-imx219.dtbo";
                };
                k3-j721e-vision-apps.dtbo {
                        description = "Linux kernel, FDT blob";
                        fdt = "k3-j721e-vision-apps.dtbo";
                };
                k3-j721e-edgeai-apps.dtbo {
                        description = "Linux kernel, FDT blob";
                        fdt = "k3-j721e-edgeai-apps.dtbo";
                };
                k3-j721e-sk-rpi-hdr-ehrpwm.dtbo {
                        description = "Linux kernel, FDT blob";
                        fdt = "k3-j721e-sk-rpi-hdr-ehrpwm.dtbo";
                };
        };
};
```
